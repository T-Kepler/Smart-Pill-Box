#include "oled.h"
#include "i2c.h"
#include "hardware_config.h"
#include <string.h>

#define SSD1306_WIDTH  128
#define SSD1306_HEIGHT 64
#define SSD1306_PAGES  8
#define SSD1306_ADDR   0x78

static uint8_t oled_buffer[SSD1306_WIDTH * SSD1306_PAGES];
static const uint8_t font_ascii[96][6] = {
    {0x00,0x00,0x00,0x00,0x00,0x00},
    {0x00,0x00,0x5F,0x00,0x00,0x00},
    {0x00,0x07,0x00,0x07,0x00,0x00},
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    {0x00,0x00,0x00,0x00,0x00,0x00}
};
 
/**
 * @brief 向 OLED 显示器发送命令
 * @details 该函数通过 I2C 总线向 SSD1306 OLED 显示器发送控制命令，
 *          用于配置显示参数、清除屏幕、设置光标位置等操作
 * @param cmd 要发送的控制命令字节
 * @return 无
 * @note I2C 通信中，第一个字节 0x00 表示后续字节为命令而非数据
 */
static void OLED_WriteCmd(uint8_t cmd)
{
    uint8_t buf[2] = {0x00, cmd};
    HAL_I2C_Master_Transmit(&hi2c1, SSD1306_ADDR, buf, 2, 100);
}
 
/**
 * @brief 初始化 OLED 显示器
 * @details 该函数初始化 SSD1306 OLED 显示器，配置显示参数、时钟、对比度等，
 *          清除屏幕并更新显示内容
 * @param 无
 * @return 无
 * @note 函数按照 SSD1306 数据手册推荐的初始化序列配置显示器
 */
void OLED_Init(void)
{
    HAL_Delay(200);
    OLED_WriteCmd(0xAE);
    OLED_WriteCmd(0xD5);
    OLED_WriteCmd(0x80);
    OLED_WriteCmd(0xA8);
    OLED_WriteCmd(0x3F);
    OLED_WriteCmd(0xD3);
    OLED_WriteCmd(0x00);
    OLED_WriteCmd(0x40);
    OLED_WriteCmd(0x8D);
    OLED_WriteCmd(0x14);
    OLED_WriteCmd(0x20);
    OLED_WriteCmd(0x00);
    OLED_WriteCmd(0xA1);
    OLED_WriteCmd(0xC8);
    OLED_WriteCmd(0xDA);
    OLED_WriteCmd(0x12);
    OLED_WriteCmd(0x81);
    OLED_WriteCmd(0xCF);
    OLED_WriteCmd(0xD9);
    OLED_WriteCmd(0xF1);
    OLED_WriteCmd(0xDB);
    OLED_WriteCmd(0x40);
    OLED_WriteCmd(0xA4);
    OLED_WriteCmd(0xA6);
    OLED_WriteCmd(0xAF);
    OLED_Clear();
    OLED_UpdateDisplay();
}
 
/**
 * @brief 清除 OLED 显示器屏幕
 * @details 该函数将 OLED 显示缓冲区中的所有像素设置为 0（黑色），
 *          从而清除屏幕上的所有显示内容
 * @param 无
 * @return 无
 * @note 该函数只清除显示缓冲区，需要调用 OLED_UpdateDisplay 才能将清除结果更新到屏幕
 */
void OLED_Clear(void)
{
    memset(oled_buffer, 0, sizeof(oled_buffer));
}

/**
 * @brief 在 OLED 屏幕上显示一个 ASCII 字符
 * @details 该函数在指定的坐标位置显示一个 ASCII 字符，
 *          字符宽度为 6 像素，从字库中读取字符的点阵数据
 *          并写入显示缓冲区。支持 95 个可打印 ASCII 字符（从空格开始）
 * @param x 字符显示的水平坐标（0-127）
 * @param y 字符显示的垂直页号（0-7），每页高度为 8 像素
 * @param ch 要显示的 ASCII 字符
 * @return 无
 * @note 该函数只更新显示缓冲区，需要调用 OLED_UpdateDisplay 才能将字符显示到屏幕
 *       如果字符超出可打印范围，将显示空格字符
 */
void OLED_ShowChar(uint8_t x, uint8_t y, char ch)
{
    uint8_t i;
    uint8_t idx = ch - ' ';
    if (idx >= 95) idx = 0;
    if (x >= SSD1306_WIDTH || y >= SSD1306_PAGES) return;
    for (i = 0; i < 6; i++)
    {
        if ((x + i) < SSD1306_WIDTH)
        {
            oled_buffer[(y * SSD1306_WIDTH) + x + i] = font_ascii[idx][i];
        }
    }
}
 
/**
 * @brief 在 OLED 屏幕上显示一个字符串
 * @details 该函数在指定的坐标位置显示一个以空字符结尾的字符串，
 *          通过循环调用 OLED_ShowChar 函数逐个显示字符。
 *          每个字符宽度为 6 像素，字符串会从起始位置向右依次显示。
 *          当字符串超出屏幕宽度时，自动停止显示剩余字符
 * @param x 字符串显示的起始水平坐标（0-127）
 * @param y 字符串显示的垂直页号（0-7），每页高度为 8 像素
 * @param str 指向以空字符结尾的字符串的指针
 * @return 无
 * @note 该函数只更新显示缓冲区，需要调用 OLED_UpdateDisplay 才能将字符串显示到屏幕
 *       当字符串超出屏幕右边界时，剩余字符将不会显示
 */
void OLED_ShowString(uint8_t x, uint8_t y, char *str)
{
    uint8_t xoffset = x;
    while (*str)
    {
        OLED_ShowChar(xoffset, y, *str);
        xoffset += 6;
        if (xoffset >= SSD1306_WIDTH) break;
        str++;
    }
}
 
/**
 * @brief 在 OLED 屏幕上显示一个数字
 * @details 该函数将 32 位无符号整数转换为指定长度的字符串，
 *          并在指定的坐标位置显示。转换过程从低位到高位逐位提取数字，
 *          如果数字的实际位数小于指定长度，会在前面自动补零。
 *          最终通过调用 OLED_ShowString 函数将数字显示到屏幕
 * @param x 数字显示的起始水平坐标（0-127）
 * @param y 数字显示的垂直页号（0-7），每页高度为 8 像素
 * @param num 要显示的数字（32 位无符号整数）
 * @param len 数字显示的长度（位数），范围 1-10
 * @return 无
 * @note 该函数只更新显示缓冲区，需要调用 OLED_UpdateDisplay 才能将数字显示到屏幕
 *       如果数字超过指定长度的最大值（如 len=2 时 num>99），将显示截断后的结果
 *       每个数字字符宽度为 6 像素，总显示宽度为 len * 6 像素
 */
void OLED_ShowNum(uint8_t x, uint8_t y, uint32_t num, uint8_t len)
{
    uint8_t i;
    char buf[12];
    for (i = 0; i < len; i++)
    {
        buf[len - 1 - i] = '0' + (num % 10);
        num /= 10;
    }
    buf[len] = '\0';
    OLED_ShowString(x, y, buf);
}
 
/**
 * @brief 在 OLED 屏幕上显示一个浮点数
 * @details 该函数将浮点数格式化为指定格式的字符串并显示在 OLED 屏幕上。
 *          支持负数显示（自动添加负号），整数部分和小数部分可以分别指定显示长度。
 *          整数部分如果位数不足会在前面补零，小数部分采用四舍五入方式处理。
 *          最终通过调用 OLED_ShowString 函数将格式化后的浮点数显示到屏幕
 * @param x 浮点数显示的起始水平坐标（0-127）
 * @param y 浮点数显示的垂直页号（0-7），每页高度为 8 像素
 * @param num 要显示的浮点数（单精度浮点数）
 * @param int_len 整数部分的显示长度（位数），范围 0-10，为 0 时不显示整数部分
 * @param dec_len 小数部分的显示长度（位数），范围 0-7，为 0 时不显示小数部分
 * @return 无
 * @note 该函数只更新显示缓冲区，需要调用 OLED_UpdateDisplay 才能将浮点数显示到屏幕
 *       如果整数部分超过指定长度的最大值，将显示截断后的结果
 *       小数部分采用四舍五入方式处理，如 dec_len=2 时 3.456 显示为 3.46
 *       每个字符宽度为 6 像素，总显示宽度约为 (int_len + dec_len + 1) * 6 像素（含负号和小数点）
 */
void OLED_ShowFloat(uint8_t x, uint8_t y, float num, uint8_t int_len, uint8_t dec_len)
{
    uint8_t i;
    char buf[16];
    uint32_t int_part;
    uint32_t dec_part;
    uint8_t pos = 0;

    if (num < 0)
    {
        buf[pos++] = '-';
        num = -num;
    }

    int_part = (uint32_t)num;
    float dec_val = num - (float)int_part;
    for (i = 0; i < dec_len; i++) dec_val *= 10.0f;
    dec_part = (uint32_t)(dec_val + 0.5f);

    if (int_len > 0)
    {
        char ibuf[12];
        for (i = 0; i < int_len; i++)
        {
            ibuf[int_len - 1 - i] = '0' + (int_part % 10);
            int_part /= 10;
        }
        for (i = 0; i < int_len; i++) buf[pos++] = ibuf[i];
    }

    if (dec_len > 0)
    {
        buf[pos++] = '.';
        char dbuf[8];
        for (i = 0; i < dec_len; i++)
        {
            dbuf[dec_len - 1 - i] = '0' + (dec_part % 10);
            dec_part /= 10;
        }
        for (i = 0; i < dec_len; i++) buf[pos++] = dbuf[i];
    }
    buf[pos] = '\0';
    OLED_ShowString(x, y, buf);
}
 
/**
 * @brief 在 OLED 屏幕上显示一个百分比值
 * @details 该函数在指定的坐标位置显示百分比值，格式为 "XXX%"。
 *          百分比值以 3 位数字显示（前面自动补零），并在后面添加百分号。
 *          如果传入的百分比值超过 100，会自动限制为 100。
 *          通过调用 OLED_ShowNum 显示数字部分，再调用 OLED_ShowString 显示百分号
 * @param x 百分比显示的起始水平坐标（0-127）
 * @param y 百分比显示的垂直页号（0-7），每页高度为 8 像素
 * @param percent 要显示的百分比值（0-100），超过 100 时自动限制为 100
 * @return 无
 * @note 该函数只更新显示缓冲区，需要调用 OLED_UpdateDisplay 才能将百分比显示到屏幕
 *       数字部分固定显示为 3 位，如 5 显示为 "005%"，100 显示为 "100%"
 *       百分号显示在数字右侧 18 像素处（3 个数字字符 * 6 像素）
 *       总显示宽度约为 24 像素（18 像素数字 + 6 像素百分号）
 */
void OLED_ShowPercent(uint8_t x, uint8_t y, uint8_t percent)
{
    if (percent > 100) percent = 100;
    OLED_ShowNum(x, y, percent, 3);
    OLED_ShowString(x + 18, y, "%");
}
 
/**
 * @brief 将显示缓冲区的内容更新到 OLED 屏幕
 * @details 该函数通过 I2C 接口将显示缓冲区中的数据逐页写入 OLED 显示器。
 *          SSD1306 OLED 显示器分为 8 页，每页高度为 8 像素，宽度为 128 像素。
 *          函数循环遍历所有页面，对每页执行以下操作：
 *          1. 设置页面地址（命令 0xB0 + 页号）
 *          2. 设置列地址的低 4 位（命令 0x00）
 *          3. 设置列地址的高 4 位（命令 0x10）
 *          4. 通过 I2C 将该页的显示数据写入显示器的显存
 *          超时时间设置为 100ms
 * @param 无
 * @return 无
 * @note 该函数必须在调用其他显示函数（如 OLED_ShowChar、OLED_ShowString 等）之后调用，
 *       才能将缓冲区的内容真正显示到屏幕上
 *       使用 I2C1 接口进行通信，OLED 器件地址为 SSD1306_ADDR
 *       数据写入寄存器地址为 0x40，表示后续数据为显示数据
 */
void OLED_UpdateDisplay(void)
{
    uint8_t page;
    for (page = 0; page < SSD1306_PAGES; page++)
    {
        OLED_WriteCmd(0xB0 + page);
        OLED_WriteCmd(0x00);
        OLED_WriteCmd(0x10);
        HAL_I2C_Mem_Write(&hi2c1, SSD1306_ADDR, 0x40, I2C_MEMADD_SIZE_8BIT,
                          &oled_buffer[page * SSD1306_WIDTH], SSD1306_WIDTH, 100);
    }
}
